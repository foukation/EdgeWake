## wake_word_detection/ESP32/esp-sr_wake_word_sdk_builder/sdkconfig.defaults
```kconfig
# ===========================================================================
# Wake Word SDK Builder Default Configuration
# ===========================================================================
#
# This file contains default configuration for building wake_word_sdk.
#

# ---------------------------------------------------------------------------
# ESP-SR Speech Recognition Configuration
# ---------------------------------------------------------------------------

# Enable Wakenet (wake word detection)
CONFIG_SR_WN_WN9_HIESP=y

# Enable AFE (Audio Front-End)
CONFIG_SR_AFE_ENABLE=y

# ---------------------------------------------------------------------------
# Memory Configuration
# ---------------------------------------------------------------------------

# Use PSRAM (external RAM)
CONFIG_SPIRAM=y
CONFIG_SPIRAM_MODE_OCT=y
CONFIG_SPIRAM_SPEED_80M=y

# ---------------------------------------------------------------------------
# FreeRTOS Configuration
# ---------------------------------------------------------------------------

# Enable FreeRTOS statistics
CONFIG_FREERTOS_USE_TRACE_FACILITY=y
CONFIG_FREERTOS_GENERATE_RUN_TIME_STATS=y

# ---------------------------------------------------------------------------
# Log Configuration
# ---------------------------------------------------------------------------

# Default log level
CONFIG_LOG_DEFAULT_LEVEL_INFO=y
```

## wake_word_detection/ESP32/wake_word_detection_sdk_builder/sdkconfig.defaults
```kconfig
# ===========================================================================
# wake_word_detection_sdk_builder - sdkconfig.defaults (基准默认配置)
# Target: ESP32-S3, ESP-IDF v5.4.3
# ---------------------------------------------------------------------------
# 【必须存在】IDF 只有读到"基准 sdkconfig.defaults"时，才会顺带读取同名的
# sdkconfig.defaults.<target>（如 sdkconfig.defaults.esp32s3）。缺少本文件时
# 默认列表为空，target 版本永远不会被读取，PSRAM 等配置全部失效。
#
# 说明：本工程只产出 libwake_word_detection_sdk.a（app_main 为空、无 tensor_arena），
# PSRAM 开不开不影响库产物；此处配置仅为与 demo 工程保持一致。
# ===========================================================================

# 编库工程 app_main 为空，看门狗保持默认即可；此行仅占位以保证基准文件非空
# 注意：IDF 该配置合法范围 1~60 秒，60 为上限（写 240 会超范围被拒、退回默认 5）
CONFIG_ESP_TASK_WDT_TIMEOUT_S=60
```
